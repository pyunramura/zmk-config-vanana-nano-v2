## boards/shields/naan/Kconfig.defconfig
```kconfig
# Copyright (c) 2020 dELLIKEEb
# SPDX-License-Identifier: MIT

if SHIELD_NAAN_REV2

config ZMK_KEYBOARD_NAME
	default "NaaN rev2"

endif
```

## config/boards/shields/vanana/Kconfig.defconfig
```kconfig
# Copyright (c) 2020 dELLIKEEb
# SPDX-License-Identifier: MIT

if SHIELD_VANANA_REV2

config ZMK_KEYBOARD_NAME
	default "Vanana Nice!Nano v2"

endif
```
